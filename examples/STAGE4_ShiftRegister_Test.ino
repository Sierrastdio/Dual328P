/*
 * ============================================================================
 * STAGE 4 테스트: 74HC595 시프트 레지스터
 * ============================================================================
 * 목표: 시프트 레지스터를 통해 8비트 순차 데이터 전송 확인
 * 
 * 핀 배치:
 * - PD0: SER (Serial Input, 74HC595 pin 14)
 * - PD1: SCK (Shift Clock, 74HC595 pin 11)
 * - PC3: RCK (Latch Clock, 74HC595 pin 12)
 * 
 * 74HC595 출력 (QA~QH → 8개 LED):
 * - QA (pin 15): LED D0
 * - QB (pin 1):  LED D1
 * - QC (pin 2):  LED D2
 * - QD (pin 3):  LED D3
 * - QE (pin 4):  LED D4
 * - QF (pin 5):  LED D5
 * - QG (pin 6):  LED D6
 * - QH (pin 7):  LED D7
 * 
 * 기타 74HC595 핀 연결:
 * - pin 10 (SCLR#): VCC (리셋 비활성화)
 * - pin 13 (G#): GND (항상 활성화)
 * - pin 9 (QH'): N/C (연쇄 출력 미사용)
 * 
 * 예상 결과:
 * ✓ 8개 LED가 0→1→2→...→255 이진 패턴으로 변한다
 * ✓ 로직 애널라이저에서 3개 신호(SER, SCK, RCK)의 타이밍 확인
 * 
 * 작동 원리:
 * 
 *  __           __           __
 * |  |_________|  |_________|  |_______  (SCK)
 * 
 * _|¯|_|¯|_|¯|_|¯|_|¯|_|¯|_|¯|_|¯|_    (SER, 8비트)
 * 
 *  ___________|¯¯|____________|¯¯|____  (RCK, 래치)
 * 
 * Q값 변경점: RCK의 rising edge
 */

#include <avr/io.h>
#include <util/delay.h>

// IO 매크로
#define SER_SET()    (PORTD |= (1 << 0))
#define SER_CLR()    (PORTD &= ~(1 << 0))
#define SCK_SET()    (PORTD |= (1 << 1))
#define SCK_CLR()    (PORTD &= ~(1 << 1))
#define RCK_SET()    (PORTC |= (1 << 3))
#define RCK_CLR()    (PORTC &= ~(1 << 3))

void setup() {
    // PD0, PD1 출력
    DDRD |= (1 << 0) | (1 << 1);
    
    // PC3 출력
    DDRC |= (1 << 3);
    
    // 초기 상태: 모두 LOW
    PORTD &= ~((1 << 0) | (1 << 1));
    PORTC &= ~(1 << 3);
}

int main(void) {
    setup();
    
    while (1) {
        // 테스트 1: 0→255 증가
        pattern_count_up();
        
        // 테스트 2: 비트 패턴
        pattern_bits();
        
        // 테스트 3: 회전 패턴
        pattern_rotate();
    }
}

// 8비트 값을 74HC595에 입력
// 타이밍 다이어그램:
//
//  SER  _|¯|_|¯|_|¯|_|¯|_|¯|_|¯|_|¯|_   (MSB부터 LSB 순)
//       ──┬─┬─┬─┬─┬─┬─┬─┬─┬──────────   (SCK 상승에 샘플링)
//  SCK  __| |_| |_| |_| |_| |_| |_| |_  (8번 펄스)
//       ────────────────────┬──────────
//  RCK  ____________________| |________  (SER→Q로 전송)
//
void shift_register_write(uint8_t value) {
    // 8비트 순차 입력 (MSB → LSB)
    for (int8_t i = 7; i >= 0; i--) {
        // Step 1: SER에 비트 설정
        if (value & (1 << i)) {
            SER_SET();    // 1
        } else {
            SER_CLR();    // 0
        }
        
        _delay_us(1);  // 신호 안정화
        
        // Step 2: SCK 펄스 (상승 엣지에 데이터 샘플링)
        SCK_SET();
        _delay_us(1);
        SCK_CLR();
        _delay_us(1);
    }
    
    // Step 3: RCK 펄스 (Shift Register → Q 출력)
    RCK_SET();
    _delay_us(1);
    RCK_CLR();
    _delay_us(1);
    
    // 정리
    SER_CLR();
}

// 테스트 1: 0→255 증가 (이진 카운팅)
void pattern_count_up(void) {
    for (uint16_t count = 0; count < 10; count++) {  // 10 사이클
        for (uint8_t value = 0; value < 256; value++) {
            shift_register_write(value);
            _delay_ms(50);  // 50ms 간격
        }
    }
}

// 테스트 2: 특정 비트 패턴
void pattern_bits(void) {
    uint8_t patterns[] = {
        0b00000001,  // 1개 켜기
        0b00000011,  // 2개 켜기
        0b00000111,  // 3개 켜기
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        0b11111111,  // 8개 켜기
    };
    
    for (uint8_t rep = 0; rep < 10; rep++) {
        for (uint8_t i = 0; i < 8; i++) {
            shift_register_write(patterns[i]);
            _delay_ms(300);
        }
    }
}

// 테스트 3: 회전 패턴 (좌측 시프트)
void pattern_rotate(void) {
    for (uint8_t rep = 0; rep < 20; rep++) {
        for (uint8_t i = 0; i < 8; i++) {
            uint8_t pattern = 1 << i;  // 한 비트씩 이동
            shift_register_write(pattern);
            _delay_ms(150);
        }
    }
}

/*
 * ============================================================================
 * 로직 애널라이저 확인 (매우 중요!)
 * ============================================================================
 * 
 * 분석 방법 (Pulseview 기준):
 * 
 * 1. 채널 설정:
 *    - CH0: PD0 (SER)
 *    - CH1: PD1 (SCK)
 *    - CH2: PC3 (RCK)
 * 
 * 2. 샘플 속도: 1MHz (최소)
 * 
 * 3. 예상 파형 (0x55 = 0b01010101 입력):
 * 
 *    시간:  0  1  2  3  4  5  6  7  8  9 10 11 12 13 14 15 16 17 18 19 (μs)
 *    
 *    SER   0  0  1  1  0  0  1  1  0  0  1  0  0  1  1  0  0  ...
 *    
 *    SCK   ─┐ ├─┬─├─┬─├─┬─├─┬─├─┬─├─┬─├─┬─┤  (8번 펄스)
 *          │ └─┘ └─┘ └─┘ └─┘ └─┘ └─┘ └─┘ └─┘
 *    
 *    RCK   ─────┐                      ├──┐
 *             └──────────────────────────┘ └──...  (마지막 펄스)
 * 
 * 4. 측정값:
 *    - SCK period: ~2μs (실제 _delay_us(1) 두 번 호출)
 *    - SCK pulse width: ~1μs
 *    - RCK pulse width: ~1μs
 *    - SER → SCK rising edge 간격: <1μs
 * 
 * 5. 검증 체크리스트:
 *    ✓ SER 신호가 정확히 8비트 보이는가?
 *    ✓ SCK는 정확히 8번 펄싱하는가?
 *    ✓ 각 SCK rising edge에 SER이 변한 후 샘플링되는가?
 *    ✓ RCK는 8번 SCK 후에만 펄싱하는가?
 *    ✓ RCK 사이 간격이 규칙적인가 (50ms)?
 * 
 * ============================================================================
 * 멀티미터 확인
 * ============================================================================
 * 
 * DC 전압 측정:
 * - PD0 (SER): 점멸 (0V ↔ 5V)
 * - PD1 (SCK): 점멸 (0V ↔ 5V)
 * - PC3 (RCK): 주로 0V (간헐적 5V)
 * 
 * 74HC595 출력 (Q0~Q7):
 * - pattern_count_up 실행 중:
 *   Q0: ~190Hz (1/n 주파수로 점멸)
 *   Q1: ~95Hz (Q0의 절반)
 *   Q2: ~47.5Hz
 *   ... (이진 카운터 느낌)
 * 
 * ============================================================================
 * 문제 해결
 * ============================================================================
 * 
 * 증상 1: LED가 작동하지 않음
 * → 로직 애널라이저로 신호 확인
 *   ✗ SER 신호가 보이지 않음: PD0 배선/마이크로 연결 재확인
 *   ✗ SCK 신호가 보이지 않음: PD1 배선/마이크로 연결 재확인
 *   ✗ RCK 신호가 보이지 않음: PC3 배선/마이크로 연결 재확인
 * → 74HC595의 VCC/GND 재확인
 * → 74HC595의 pin 10(SCLR#) = VCC 확인
 * → 74HC595의 pin 13(G#) = GND 확인
 * 
 * 증상 2: LED가 무작위로 켜진다
 * → RCK 신호 타이밍 확인 (노이즈 리드?)
 * → 풀업/풀다운 저항 추가 고려
 * → SCK 펄스 사이 지연 증가 (1us → 10us)
 * 
 * 증상 3: 패턴이 반복되지 않음
 * → _delay_ms() 함수가 작동하는지 크리스탈 확인
 * → 코드의 for 루프 조건 재확인
 * 
 * 증상 4: 신호의 일부 비트만 이상
 * → 해당 SER 변환 타이밍 (if 문) 재확인
 * → 특정 비트에서 SCK 펄스 누락 확인
 * 
 * ============================================================================
 * 다음 단계 (STAGE 5)로 전환 조건
 * ============================================================================
 * 
 * 다음 조건을 모두 만족할 때 STAGE 5로 전환:
 * ✓ 로직 애널라이저에서 완벽한 SER/SCK/RCK 타이밍 확인
 * ✓ pattern_count_up에서 0~255 모두 정상 표시
 * ✓ pattern_bits에서 명확한 단계별 켜짐/꺼짐
 * ✓ pattern_rotate에서 회전 패턴 명확함
 * ✓ 멀티미터 DC 전압 측정 일관성
 * 
 * ============================================================================
 */
