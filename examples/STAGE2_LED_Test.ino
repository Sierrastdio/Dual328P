/*
 * ============================================================================
 * STAGE 2 테스트: Core 1 최소 구성
 * ============================================================================
 * 목표: ATmega328P 기본 동작 확인 (LED 8개 점멸)
 * 
 * 핀 배치:
 * - PD2~PD7: D0~D5 (6개 LED)
 * - PB0~PB1: D6~D7 (2개 LED)
 * - PC5: 입력 (버튼, 선택사항)
 * 
 * 예상 결과:
 * ✓ 8개 LED가 동시에 깜빡인다
 * ✓ 1초 간격으로 ON/OFF 반복
 * ✓ 로직 애널라이저에서 정사각형 파형 확인
 */

#include <avr/io.h>
#include <util/delay.h>

void setup() {
    // PORTD(PD2~7) 출력으로 설정
    DDRD = 0xFC;  // PD0,1 제외, PD2~7 출력
    
    // PORTB(PB0~1) 출력으로 설정
    DDRB = 0x07;  // PB0~2 출력 (PB2는 나중에 사용)
    
    // PORTC(PC5) 입력으로 설정
    DDRC = 0x00;  // 모두 입력
    PORTC = 0xFF; // 풀업 저항 활성화
}

int main(void) {
    setup();
    
    while (1) {
        // ===== 테스트 1: 간단한 점멸 =====
        simple_blink();
        
        // ===== 테스트 2: 순차 켜기 =====
        sequential_lights();
        
        // ===== 테스트 3: 버튼 입력 반응 =====
        button_test();
    }
}

// 테스트 1: 모든 LED 동시 ON/OFF
void simple_blink(void) {
    // LED ON (모든 PD, PB 포트 HIGH)
    PORTD = 0xFC;  // PD2~7 = 1
    PORTB = 0x03;  // PB0~1 = 1
    _delay_ms(500);
    
    // LED OFF
    PORTD = 0x00;
    PORTB = 0x00;
    _delay_ms(500);
}

// 테스트 2: 순차적으로 LED 켜기 (이진 카운팅)
void sequential_lights(void) {
    for (uint8_t i = 0; i < 256; i++) {
        // 하위 6비트 → PD2~7
        uint8_t portd_val = (i & 0x3F) << 2;  // i의 비트6~1 → PD7~2
        PORTD = portd_val;
        
        // 상위 2비트 → PB0~1
        uint8_t portb_val = (i >> 6) & 0x03;  // i의 비트7~6 → PB1~0
        PORTB = portb_val;
        
        _delay_ms(50);
    }
}

// 테스트 3: 버튼(PC5)으로 제어
void button_test(void) {
    #define BUTTON (PINC & (1 << 5))
    
    static uint8_t led_state = 0;
    static uint8_t button_prev = 1;
    
    uint8_t button_now = (BUTTON >> 5);
    
    // 버튼을 눌렀을 때 (HIGH→LOW)
    if (button_prev && !button_now) {
        led_state ^= 0xFF;  // LED 상태 토글
    }
    
    if (led_state) {
        PORTD = 0xFC;
        PORTB = 0x03;
    } else {
        PORTD = 0x00;
        PORTB = 0x00;
    }
    
    button_prev = button_now;
    _delay_ms(10);
}

/*
 * ============================================================================
 * 로직 애널라이저로 확인 (Pulseview, Sigrok 등)
 * ============================================================================
 * 
 * 예상 파형 (simple_blink):
 * 
 * PD2 ─┐        ┌────────────┐
 *      └────────┘            └─ (500ms 간격)
 * 
 * PD3 ─┐        ┐────────────┐
 *      └────────┘            └─ (동일)
 * 
 * ... (PD4~7, PB0~1도 동일)
 * 
 * 주의: 가로축 0.1ms/div 또는 100us/div로 설정 권장
 * 
 * ============================================================================
 * 멀티미터 확인 사항
 * ============================================================================
 * 
 * 1. 전원 측정:
 *    - VCC (핀 7/20): 5.0V
 *    - GND (핀 8/22): 0V
 * 
 * 2. RESET 핀 (핀 1):
 *    - HIGH (약 5V)
 *    - 크리스탈 근처에 바이패스 캡 설치 확인
 * 
 * 3. LED 핀 (PD2~7, PB0~1):
 *    - LED ON: ~4.8V(아무 부하 없을 때), <0.2V (LED의 역방향 저항)
 *    - LED OFF: ~0V 또는 5V (배선 상태)
 * 
 * ============================================================================
 * 문제 해결
 * ============================================================================
 * 
 * 증상 1: LED가 안 켜진다
 * → 멀티미터의 전원 연결 다시 확인
 * → RESET 핀이 HIGH인지 확인
 * → 크리스탈 근처 신호 → 로직 애널라이저로 진동 확인
 * → LED 극성 확인 (빨강=양극, 검정=음극)
 * 
 * 증상 2: 일부 LED만 작동
 * → 해당 포트 핀의 배선 재확인
 * → DDRD, DDRB 초기화 코드 재확인
 * → 해당 핀이 이미 다른 용도로 사용되진 않는지 확인
 * 
 * 증상 3: LED가 항상 켜진 상태
 * → PORTD/PORTB 값이 0이 되는지 확인
 * → GND 연결 재확인
 * → 저항이 정상인지 확인 (단락 여부)
 * 
 * ============================================================================
 */
